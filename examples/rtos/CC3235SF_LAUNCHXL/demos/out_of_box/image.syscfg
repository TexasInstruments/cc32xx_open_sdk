/**
 * @cliArgs --device "CC3235SF" --package "Default" --part "Default" --ccxxImageMode --product "simplelink_cc32xx_sdk@6_10_00_05"
 * @versions {"data":"2020052512","timestamp":"2020052512","tool":"1.12.0","templates":"2020052512"}
 */

/**
 * Import the modules used in this configuration.
 */
const General     = scripting.addModule("/ti/drivers/net/imagecreator/new_design/Device/General");
const Ota         = scripting.addModule("/ti/drivers/net/imagecreator/new_design/Device/Ota");
const Network     = scripting.addModule("/ti/drivers/net/imagecreator/new_design/NetworkServices/Network");
const CertStore   = scripting.addModule("/ti/drivers/net/imagecreator/new_design/UserFiles/CertStore");
const MCUImage    = scripting.addModule("/ti/drivers/net/imagecreator/new_design/UserFiles/MCUImage");
const ServicePack = scripting.addModule("/ti/drivers/net/imagecreator/new_design/UserFiles/ServicePack");
const fileTree    = scripting.addModule("/ti/drivers/net/imagecreator/new_design/UserFiles/fileTree");
const fileTree1   = fileTree.addInstance();
const fileTree2   = fileTree.addInstance();
const fileTree3   = fileTree.addInstance();
const fileTree4   = fileTree.addInstance();
const fileTree5   = fileTree.addInstance();
const fileTree6   = fileTree.addInstance();
const fileTree7   = fileTree.addInstance();
const fileTree8   = fileTree.addInstance();
const fileTree9   = fileTree.addInstance();
const fileTree10  = fileTree.addInstance();
const fileTree11  = fileTree.addInstance();
const fileTree12  = fileTree.addInstance();
const fileTree13  = fileTree.addInstance();
const fileTree14  = fileTree.addInstance();
const fileTree15  = fileTree.addInstance();
const fileTree16  = fileTree.addInstance();
const fileTree17  = fileTree.addInstance();
const fileTree18  = fileTree.addInstance();
const fileTree19  = fileTree.addInstance();
const Mac         = scripting.addModule("/ti/drivers/net/imagecreator/new_design/WiFi/Mac");
const Radio       = scripting.addModule("/ti/drivers/net/imagecreator/new_design/WiFi/Radio");

/**
 * Write custom configuration values to the imported modules.
 */
General.ModeSelect = "development";

MCUImage.fileSizeCfg = 262144;

fileTree.rootDirCfg = "userFiles";

fileTree1.$name              = "ti_drivers_net_imagecreator_new_design_UserFiles_fileTree0";
fileTree1.filePathCfg        = scripting.forceWrite("sys\\mcubootinfo.bin");
fileTree1.includeOTA         = true;
fileTree1.failSafeCfg        = true;
fileTree1.secureCfg          = true;
fileTree1.publicWriteCfg     = true;
fileTree1.noSignatureTestCfg = true;

fileTree2.$name       = "ti_drivers_net_imagecreator_new_design_UserFiles_fileTree1";
fileTree2.filePathCfg = scripting.forceWrite("www\\css\\style.css");
fileTree2.failSafeCfg = true;
fileTree2.includeOTA  = true;

fileTree3.$name       = "ti_drivers_net_imagecreator_new_design_UserFiles_fileTree2";
fileTree3.filePathCfg = scripting.forceWrite("www\\images\\icons\\help.png");
fileTree3.includeOTA  = true;
fileTree3.failSafeCfg = true;

fileTree4.$name       = "ti_drivers_net_imagecreator_new_design_UserFiles_fileTree3";
fileTree4.filePathCfg = scripting.forceWrite("www\\images\\icons\\menu.png");
fileTree4.includeOTA  = true;
fileTree4.failSafeCfg = true;

fileTree5.$name       = "ti_drivers_net_imagecreator_new_design_UserFiles_fileTree4";
fileTree5.filePathCfg = scripting.forceWrite("www\\images\\icons\\wireless.png");
fileTree5.includeOTA  = true;
fileTree5.failSafeCfg = true;

fileTree6.$name       = "ti_drivers_net_imagecreator_new_design_UserFiles_fileTree5";
fileTree6.filePathCfg = scripting.forceWrite("www\\images\\icons\\wirelessfull.png");
fileTree6.includeOTA  = true;
fileTree6.failSafeCfg = true;

fileTree7.$name       = "ti_drivers_net_imagecreator_new_design_UserFiles_fileTree6";
fileTree7.filePathCfg = scripting.forceWrite("www\\images\\rotate360.jpg");
fileTree7.includeOTA  = true;

fileTree8.$name       = "ti_drivers_net_imagecreator_new_design_UserFiles_fileTree7";
fileTree8.filePathCfg = scripting.forceWrite("www\\images\\tilogo.gif");
fileTree8.includeOTA  = true;
fileTree8.failSafeCfg = true;

fileTree9.$name       = "ti_drivers_net_imagecreator_new_design_UserFiles_fileTree8";
fileTree9.filePathCfg = scripting.forceWrite("www\\js\\jquery.min.js");
fileTree9.includeOTA  = true;
fileTree9.failSafeCfg = true;

fileTree10.$name       = "ti_drivers_net_imagecreator_new_design_UserFiles_fileTree9";
fileTree10.filePathCfg = scripting.forceWrite("www\\js\\scripts.js");
fileTree10.includeOTA  = true;
fileTree10.failSafeCfg = true;

fileTree11.$name       = "ti_drivers_net_imagecreator_new_design_UserFiles_fileTree10";
fileTree11.filePathCfg = scripting.forceWrite("www\\demo.html");
fileTree11.includeOTA  = true;
fileTree11.failSafeCfg = true;

fileTree12.$name       = "ti_drivers_net_imagecreator_new_design_UserFiles_fileTree11";
fileTree12.filePathCfg = scripting.forceWrite("www\\help.html");
fileTree12.includeOTA  = true;
fileTree12.failSafeCfg = true;

fileTree13.$name       = "ti_drivers_net_imagecreator_new_design_UserFiles_fileTree12";
fileTree13.filePathCfg = scripting.forceWrite("www\\index.html");
fileTree13.includeOTA  = true;
fileTree13.failSafeCfg = true;

fileTree14.$name       = "ti_drivers_net_imagecreator_new_design_UserFiles_fileTree13";
fileTree14.filePathCfg = scripting.forceWrite("www\\settings.html");
fileTree14.includeOTA  = true;
fileTree14.failSafeCfg = true;

fileTree15.$name       = "ti_drivers_net_imagecreator_new_design_UserFiles_fileTree14";
fileTree15.filePathCfg = scripting.forceWrite("ca-priv-key.der");
fileTree15.failSafeCfg = true;

fileTree16.$name       = "ti_drivers_net_imagecreator_new_design_UserFiles_fileTree15";
fileTree16.filePathCfg = scripting.forceWrite("ca_in_cert_store");
fileTree16.failSafeCfg = true;

fileTree17.$name       = "ti_drivers_net_imagecreator_new_design_UserFiles_fileTree16";
fileTree17.filePathCfg = scripting.forceWrite("dummy_ota_vendor_cert.der");
fileTree17.failSafeCfg = true;

fileTree18.$name       = "ti_drivers_net_imagecreator_new_design_UserFiles_fileTree17";
fileTree18.filePathCfg = scripting.forceWrite("ota.dat");
fileTree18.failSafeCfg = true;

fileTree19.$name       = "ti_drivers_net_imagecreator_new_design_UserFiles_fileTree18";
fileTree19.filePathCfg = scripting.forceWrite("dummy-root-ca-cert");
fileTree19.includeOTA  = true;
fileTree19.failSafeCfg  = true;
